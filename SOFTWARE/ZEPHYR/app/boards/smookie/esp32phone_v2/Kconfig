## SOFTWARE/ZEPHYR/app/boards/smookie/esp32phone_v2/Kconfig
```kconfig
config HEAP_MEM_POOL_ADD_SIZE_BOARD
	int
	default 4096 if BOARD_ESP32PHONE_V2_ESP32S3_PROCPU
	default 256 if BOARD_ESP32PHONE_V2_ESP32S3_APPCPU
```

## SOFTWARE/ZEPHYR/app/boards/smookie/esp32phone_v2/Kconfig.esp32phone_v2
```kconfig
# esp32PhoneV2 Mainboard (PCB4), ESP32-S3-WROOM-1U-N16R8

config BOARD_ESP32PHONE_V2
	select SOC_ESP32S3_WROOM_N16R8
	select SOC_ESP32S3_PROCPU if BOARD_ESP32PHONE_V2_ESP32S3_PROCPU
	select SOC_ESP32S3_APPCPU if BOARD_ESP32PHONE_V2_ESP32S3_APPCPU
```

## SOFTWARE/ZEPHYR/app/boards/smookie/esp32phone_v2/board.yml
```yaml
board:
  name: esp32phone_v2
  full_name: esp32PhoneV2 Mainboard
  vendor: smookie
  socs:
  - name: esp32s3
```
